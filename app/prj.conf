## CMakeLists.txt
```
cmake_minimum_required(VERSION 3.20)

find_package(Zephyr REQUIRED HINTS $ENV{ZEPHYR_BASE})
project(my_lora_node)

target_sources(app PRIVATE src/main.c)
```

## prj.conf
```kconfig
CONFIG_LOG=y
CONFIG_LORA=y
CONFIG_LORAWAN=y
CONFIG_LORAWAN_REGION_US915=y
CONFIG_LORA_STM32WL_SUBGHZ_RADIO=y
CONFIG_MAIN_STACK_SIZE=2048
CONFIG_SYSTEM_WORKQUEUE_STACK_SIZE=2048
CONFIG_LOG_BACKEND_UART=y
CONFIG_LORAWAN_NVM_SETTINGS=y
CONFIG_SETTINGS=y
CONFIG_SETTINGS_NVS=y
CONFIG_NVS=y
CONFIG_FLASH=y
CONFIG_FLASH_MAP=y
```

## src/main.c
```c
/*
 * Class A LoRaWAN sample application
 *
 * Copyright (c) 2020 Manivannan Sadhasivam <mani@kernel.org>
 *
 * SPDX-License-Identifier: Apache-2.0
 */

#include <zephyr/device.h>
#include <zephyr/lorawan/lorawan.h>
#include <zephyr/kernel.h>
#include <zephyr/settings/settings.h>
#include "secrets.h"

#define DELAY K_MSEC(10000)

#define LOG_LEVEL CONFIG_LOG_DEFAULT_LEVEL
#include <zephyr/logging/log.h>
LOG_MODULE_REGISTER(lorawan_class_a);

char data[] = {'h', 'e', 'l', 'l', 'o', 'w', 'o', 'r', 'l', 'd'};

static void dl_callback(uint8_t port, uint8_t flags, int16_t rssi, int8_t snr, uint8_t len,
			const uint8_t *hex_data)
{
	LOG_INF("Port %d, Pending %d, RSSI %ddB, SNR %ddBm, Time %d", port,
		flags & LORAWAN_DATA_PENDING, rssi, snr, !!(flags & LORAWAN_TIME_UPDATED));
	if (hex_data) {
		LOG_HEXDUMP_INF(hex_data, len, "Payload: ");
	}
}

static void lorwan_datarate_changed(enum lorawan_datarate dr)
{
	uint8_t unused, max_size;

	lorawan_get_payload_sizes(&unused, &max_size);
	LOG_INF("New Datarate: DR_%d, Max Payload %d", dr, max_size);
}

int main(void)
{
	const struct device *lora_dev;
	struct lorawan_join_config join_cfg;
	uint32_t dev_addr = LORAWAN_DEV_ADDR;
	uint8_t app_skey[] = LORAWAN_APP_SKEY;
	uint8_t nwk_skey[] = LORAWAN_NWK_SKEY;
	uint8_t app_eui[] = LORAWAN_APP_EUI;
    uint8_t dev_eui[] = LORAWAN_DEV_EUI;
	int ret;

	struct lorawan_downlink_cb downlink_cb = {
		.port = LW_RECV_PORT_ANY,
		.cb = dl_callback
	};

	lora_dev = DEVICE_DT_GET(DT_ALIAS(lora0));
	if (!device_is_ready(lora_dev)) {
		LOG_ERR("%s: device not ready.", lora_dev->name);
		return 0;
	}


	ret = settings_subsys_init();
	if (ret) {
		LOG_ERR("settings init failed: %d", ret);
		return 0;
	}

	ret = settings_load();
	if (ret) {
		LOG_ERR("settings load failed: %d", ret);
	}



uint16_t mask[] = { 0xFF00, 0x0000, 0x0000, 0x0000, 0x0002, 0x0000 };
ret = lorawan_start();
	if (ret < 0) {
		LOG_ERR("lorawan_start failed: %d", ret);
		return 0;
	}

    lorawan_enable_adr(false);
    ret = lorawan_set_datarate(LORAWAN_DR_4);   
    if (ret < 0) {
        LOG_ERR("lorawan_set_datarate failed: %d", ret);
        return 0;
    }

    lorawan_set_channels_mask(mask, ARRAY_SIZE(mask));	

	lorawan_register_downlink_callback(&downlink_cb);
	lorawan_register_dr_changed_callback(lorwan_datarate_changed);

	join_cfg.mode = LORAWAN_ACT_ABP;
	join_cfg.dev_eui = dev_eui;
	join_cfg.abp.dev_addr = dev_addr;
	join_cfg.abp.app_skey = app_skey;
	join_cfg.abp.nwk_skey = nwk_skey;
	join_cfg.abp.app_eui = app_eui;

	LOG_INF("Provisioned via ABP");
	ret = lorawan_join(&join_cfg);
	if (ret < 0) {
		 LOG_ERR("lorawan_join failed: %d", ret);
		 return 0;
	}

	LOG_INF("Sending data...");
	while (1) {
		ret = lorawan_send(2, data, sizeof(data),
				   LORAWAN_MSG_UNCONFIRMED);

		if (ret == -EAGAIN) {
			LOG_ERR("lorawan_send failed: %d. Continuing...", ret);
			k_sleep(DELAY);
			continue;
		}

		if (ret < 0) {
			LOG_ERR("lorawan_send failed: %d", ret);
			return 0;
		}

		LOG_INF("Data sent!");
		k_sleep(DELAY);
	}
}
```

## src/secrets.h
```c
#ifndef APP_SECRETS_H_
#define APP_SECRETS_H_

/* LoRaWAN provisioning data (MSB order) */
#define LORAWAN_DEV_ADDR		0x26011BDA
#define LORAWAN_DEV_EUI		{ 0x70, 0xB3, 0xD5, 0x7E, 0xD0, 0x01,\
				  0x23, 0x45 }
#define LORAWAN_APP_SKEY		{ 0x11, 0x22, 0x33, 0x44, 0x55, 0x66,\
				  0x77, 0x88, 0x99, 0xAA, 0xBB, 0xCC,\
				  0xDD, 0xEE, 0xFF, 0x00 }
#define LORAWAN_NWK_SKEY		{ 0x00, 0xFF, 0xEE, 0xDD, 0xCC, 0xBB,\
				  0xAA, 0x99, 0x88, 0x77, 0x66, 0x55,\
				  0x44, 0x33, 0x22, 0x11 }
#define LORAWAN_APP_EUI		{ 0x60, 0x5F, 0x9A, 0x12, 0x44, 0x0C,\
				  0x77, 0x2E }

#endif /* APP_SECRETS_H_ */
```
